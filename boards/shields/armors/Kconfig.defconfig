## boards/shields/armors/Kconfig.defconfig
```kconfig
# Copyright (c) 2022 The ZMK Contributors
# SPDX-License-Identifier: MIT

if ARMORS

config ZMK_KEYBOARD_NAME
    default "Armors"

endif
```

## boards/shields/armors/Kconfig.shield
```kconfig
# Copyright (c) 2022 The ZMK Contributors
# SPDX-License-Identifier: MIT

config SHIELD_ARMORS
   def_bool $(shields_list_contains,armors)
```

## config/boards/shields/armors/Kconfig.defconfig
```kconfig
# Copyright (c) 2022 The ZMK Contributors
# SPDX-License-Identifier: MIT

if SHIELD_ARMORS

config ZMK_KEYBOARD_NAME
    default "Armors"
    
endif
```

## config/boards/shields/shotgun/Kconfig.defconfig
```kconfig
# Copyright (c) 2022 The ZMK Contributors
# SPDX-License-Identifier: MIT

if SHIELD_SHOTGUN

config ZMK_KEYBOARD_NAME
    default "Shotgun"
    
endif
```
